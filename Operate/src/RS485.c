/************************************RS485,MODBUS***************************************
**郑州志远电子32路继电器板，技术支持工程师，高志军13838775830，淘宝搜索，志远电子
**-----------------------------------文件信息--------------------------------------------
** 文件名称:   RS485.c
** 修改时间:   2024-11-26
** 文件说明:   工业差分总线
** 数字电阻:   采用继电器板8421BCD码
----------------------------------------------------------------------------------------*/
#include "RS485.h"  //工业总线
#include "usart.h"  //串口通讯
#include "gpio.h"   //开关量收发
#include "hmi_driver.h" //触摸屏开关变色

void RS485_SendBytes(uint8_t *buf, uint8_t len)//485发送字符串
{
	Yout(3,0);//关闭接收使能
	Yout(4,1);//打开发送使能
	/* Transmit Data */
	HAL_UART_Transmit(&huart3, buf, len, 100);
//	HAL_Delay(10);
	Yout(4,0);//关闭发送使能
	Yout(3,1);//打开接收使能
}//RS485字符串发送完毕

/*继电器板指令头，板地址，功能码(31断开，32吸合)、延时时间高-中-低位，继电器号，校验和）*/
uint8_t RT32[8]={0x55,0x01,0x31,0x00,0x00,0x00,0x01,0x65}; 
void K(uint8_t port, uint8_t state)//志远电子32路继电器操作
{
	int i;
	if(port==0)
	{
		RT32[2]=0x13;
		if(state)for(i=3;i<7;i++)RT32[i]=0xFF;
		else for(i=3;i<7;i++)RT32[i]=0x00;
		for(i=1;i<33;i++)SetButtonValue(3,i,state);
	}
  else
  {
	RT32[2]=0x31+state;
	RT32[6]=port;
	}//端口通断状态
	RT32[7]=(RT32[0]+RT32[1]+RT32[2]+RT32[3]+RT32[4]+RT32[5]+RT32[6])&0xff;//校验和
	RS485_SendBytes(RT32, 8);//差分发送数据
}
void DataR(uint16_t res)//8421数字电阻,继电器板采用17-28号继电器，共位12，最大电阻999欧姆。
{
	uint8_t i;//十进制字节，百，十，个
	uint8_t j;//十进制位数，8421-0，1，2，3
	uint8_t D[3];//百位十位个位
	D[0]=res%10;//个位
	D[1]=res/10%10;//十位
	D[2]=res/100%10;//百位
	for(i=0;i<3;i++)for(j=0;j<4;j++)//百十个的8421位
	{
	K(17+i*4+j,!(D[i]&1));
	D[i]>>=1;
	}//驱动上一位的继电器
}

void IGN(uint8_t state)//点火1，熄火0
{
/*电压电流表MODBUS，板地址，设置单个寄存器、开始地址，5个寄存器，字节数，数据，校验和）*/
uint8_t POWER[8]={0x01,0x06,0x00,0x05,0x00,0x01,0x58,0x0B}; 
if(state==0){POWER[5]=0;POWER[6]=0x99;POWER[7]=0xCB;}
RS485_SendBytes(POWER,8);
}
